## board/dongyang/evc_7k_kb01_cb/Kconfig
```kconfig
# SPDX-License-Identifier: GPL-2.0+
#
# Copyright (C) 2020-2022 Texas Instruments Incorporated - https://www.ti.com/
#	Suman Anna <s-anna@ti.com>

if TARGET_AM625_A53_EVC_7K_KPB01_CB

config SYS_BOARD
       default "evc_7k_kb01_cb"

config SYS_VENDOR
       default "dongyang"

config SYS_CONFIG_NAME
       default "evc_7k_kb01_cb_evm"

source "board/dongyang/common/Kconfig"

endif

if TARGET_AM625_R5_EVC_7K_KPB01_CB
config SYS_BOARD
       default "evc_7k_kb01_cb"
config SYS_VENDOR
       default "dongyang"
config SYS_CONFIG_NAME
       default "evc_7k_kb01_cb_evm"
config SPL_LDSCRIPT
       default "arch/arm/mach-omap2/u-boot-spl.lds"
source "board/dongyang/common/Kconfig"

endif
```

## board/dongyang/evc_7k_kpb01_cb/Kconfig
```kconfig
# SPDX-License-Identifier: GPL-2.0+
#
# Copyright (C) 2020-2022 Texas Instruments Incorporated - https://www.ti.com/
#	Suman Anna <s-anna@ti.com>

if TARGET_AM625_A53_EVC_7K_KPB01_CB

config SYS_BOARD
       default "evc_7k_kpb01_cb"

config SYS_VENDOR
       default "dongyang"

config SYS_CONFIG_NAME
       default "am62x_evc_7k_kpb01_cb"

source "board/dongyang/common/Kconfig"

endif

if TARGET_AM625_R5_EVC_7K_KPB01_CB
config SYS_BOARD
       default "evc_7k_kpb01_cb"
config SYS_VENDOR
       default "dongyang"
config SYS_CONFIG_NAME
       default "am62x_evc_7k_kpb01_cb"
config SPL_LDSCRIPT
       default "arch/arm/mach-omap2/u-boot-spl.lds"
source "board/dongyang/common/Kconfig"

endif
```
